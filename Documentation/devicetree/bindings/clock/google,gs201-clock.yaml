## Documentation/devicetree/bindings/input/touchscreen/syna,s3908.yaml
```yaml
# SPDX-License-Identifier: GPL-2.0-only OR BSD-2-Clause
%YAML 1.2
---
$id: http://devicetree.org/schemas/input/touchscreen/syna,s3908.yaml#
$schema: http://devicetree.org/meta-schemas/core.yaml#

title: Synaptics TouchComm SPI touchscreen controllers

description:
  Synaptics touchscreen controllers that use the TouchComm protocol over
  SPI, such as the S3908 found in the Google Pixel 7 Pro. The sensor size
  is read from the controller; the touchscreen-* properties only adjust it.

maintainers:
  - Derek Ross <derekross@gmail.com>

allOf:
  - $ref: touchscreen.yaml#
  - $ref: /schemas/spi/spi-peripheral-props.yaml#

properties:
  compatible:
    const: syna,s3908

  reg:
    maxItems: 1

  interrupts:
    description: ATTN line, active low
    maxItems: 1

  reset-gpios:
    maxItems: 1

  vdd-supply:
    description: 1.8 V digital and I/O supply

  avdd-supply:
    description: 3.3 V analog supply

  spi-max-frequency: true
  touchscreen-inverted-x: true
  touchscreen-inverted-y: true
  touchscreen-size-x: true
  touchscreen-size-y: true
  touchscreen-swapped-x-y: true
  touchscreen-x-mm: true
  touchscreen-y-mm: true

additionalProperties: false

required:
  - compatible
  - reg
  - interrupts
  - reset-gpios

examples:
  - |
    #include <dt-bindings/interrupt-controller/irq.h>
    #include <dt-bindings/gpio/gpio.h>
    spi {
      #address-cells = <1>;
      #size-cells = <0>;

      touchscreen@0 {
        compatible = "syna,s3908";
        reg = <0>;
        interrupt-parent = <&gpa7>;
        interrupts = <0 IRQ_TYPE_LEVEL_LOW>;
        reset-gpios = <&gpp23 2 GPIO_ACTIVE_LOW>;
        vdd-supply = <&ts_vdd>;
        avdd-supply = <&ts_avdd>;
        spi-max-frequency = <10000000>;
        touchscreen-x-mm = <71>;
        touchscreen-y-mm = <154>;
      };
    };
```

## Documentation/devicetree/bindings/media/i2c/semco,sem1215sa.yaml
```yaml
# SPDX-License-Identifier: GPL-2.0-only OR BSD-2-Clause
%YAML 1.2
---
$id: http://devicetree.org/schemas/media/i2c/semco,sem1215sa.yaml#
$schema: http://devicetree.org/meta-schemas/core.yaml#

title: SEMCO SEM1215SA camera lens autofocus and stabilisation controller

maintainers:
  - Derek Ross <derekross@gmail.com>

description:
  Samsung Electro-Mechanics' SEM1215SA drives a camera module's focus and
  optical image stabilisation actuators and holds the module's calibration
  memory, controlled over I2C with 16-bit register addresses. It is the
  controller of the Google Pixel 7 Pro's folded telephoto module.

properties:
  compatible:
    const: semco,sem1215sa

  reg:
    maxItems: 1

  vbb-supply:
    description: Board supply feeding the module's regulators, switched on first.

  vio-supply:
    description: Interface (1.8 V) supply.

  vdd-supply:
    description: Actuator supply.

  vsw-supply:
    description: A switched module supply, on after vdd-supply.

required:
  - compatible
  - reg
  - vio-supply
  - vdd-supply

additionalProperties: false

examples:
  - |
    i2c {
        #address-cells = <1>;
        #size-cells = <0>;

        lens@34 {
            compatible = "semco,sem1215sa";
            reg = <0x34>;
            vio-supply = <&vddio_cam>;
            vdd-supply = <&tele_module>;
            vsw-supply = <&tele_sw>;
        };
    };
```

## Documentation/devicetree/bindings/mfd/samsung,s2mpg13-pmic.yaml
```yaml
# SPDX-License-Identifier: GPL-2.0-only OR BSD-2-Clause
%YAML 1.2
---
$id: http://devicetree.org/schemas/mfd/samsung,s2mpg13-pmic.yaml#
$schema: http://devicetree.org/meta-schemas/core.yaml#

title: Samsung S2MPG13 Power Management IC

maintainers:
  - Derek Ross <derekross@gmail.com>

description: |
  The Samsung S2MPG13 is the sub Power Management IC paired with Google's
  gs201 SoC, next to the S2MPG12 main PMIC. It has buck converters, 28 LDOs,
  power meters and NTC inputs, and is reached through the ACPM firmware.

  Its interrupt is a GPIO on the SoC. It is optional here: without it the
  regulators still work, and no PMIC event is reported.

properties:
  compatible:
    const: samsung,s2mpg13-pmic

  interrupts:
    maxItems: 1

  gpio:
    type: object
    description:
      The PMIC's eight general purpose pins. On the Pixel 7 boards they
      switch the camera supplies and wake the camera PMIC.

    properties:
      compatible:
        const: samsung,s2mpg13-gpio

      gpio-controller: true

      '#gpio-cells':
        const: 2

      gpio-line-names:
        maxItems: 8

    required:
      - compatible
      - gpio-controller
      - '#gpio-cells'

    additionalProperties: false

  regulators:
    type: object
    $ref: /schemas/regulator/samsung,s2mpg13-regulator.yaml
    description:
      List of child nodes that specify the regulators.

  wakeup-source: true

required:
  - compatible
  - regulators

additionalProperties: false

examples:
  - |
    pmic {
        compatible = "samsung,s2mpg13-pmic";

        gpio {
            compatible = "samsung,s2mpg13-gpio";
            gpio-controller;
            #gpio-cells = <2>;
        };

        regulators {
            ldo9s {
                regulator-name = "vdd_gnss_core";
                regulator-min-microvolt = <725000>;
                regulator-max-microvolt = <1300000>;
            };
        };
    };
```

## Documentation/devicetree/bindings/power/supply/maxim,max17042.yaml
```yaml
# SPDX-License-Identifier: GPL-2.0
%YAML 1.2
---
$id: http://devicetree.org/schemas/power/supply/maxim,max17042.yaml#
$schema: http://devicetree.org/meta-schemas/core.yaml#

title: Maxim 17042 fuel gauge series

maintainers:
  - Sebastian Reichel <sre@kernel.org>

allOf:
  - $ref: power-supply.yaml#
  - if:
      not:
        properties:
          compatible:
            contains:
              const: maxim,max77759-fg
    then:
      properties:
        maxim,fg-model: false
        maxim,fg-params: false

properties:
  compatible:
    enum:
      - maxim,max17042
      - maxim,max17047
      - maxim,max17050
      - maxim,max17055
      - maxim,max77705-battery
      - maxim,max77759-fg
      - maxim,max77849-battery

  reg:
    maxItems: 1

  interrupts:
    maxItems: 1
    description:
      The ALRT pin (or FG_INTB pin on MAX77759), an open-drain interrupt.

  shunt-resistor-micro-ohms:
    description:
      Resistance of rsns resistor in micro Ohms (datasheet-recommended value is 10000).
      Defining this property enables current-sense functionality.

  maxim,rsns-microohm:
    deprecated: true
    $ref: /schemas/types.yaml#/definitions/uint32
    description:
      Resistance of rsns resistor in micro Ohms (datasheet-recommended value is 10000).
      Defining this property enables current-sense functionality.

  maxim,cold-temp:
    $ref: /schemas/types.yaml#/definitions/int32
    description:
      Temperature threshold to report battery as cold (in tenths of degree Celsius).
      Default is not to report cold events.

  maxim,over-heat-temp:
    $ref: /schemas/types.yaml#/definitions/int32
    description:
      Temperature threshold to report battery as over heated (in tenths of degree Celsius).
      Default is not to report over heating events.

  maxim,dead-volt:
    $ref: /schemas/types.yaml#/definitions/uint32
    description:
      Voltage threshold to report battery as dead (in mV).
      Default is not to report dead battery events.

  maxim,over-volt:
    $ref: /schemas/types.yaml#/definitions/uint32
    description:
      Voltage threshold to report battery as over voltage (in mV).
      Default is not to report over-voltage events.

  maxim,fg-model:
    $ref: /schemas/types.yaml#/definitions/uint16-array
    minItems: 48
    maxItems: 48
    description:
      Cell characterization table of the MAX77759 fuel gauge (its "M5"
      ModelGauge m5 algorithm), as produced by Maxim's battery modelling for
      the cell. Written to registers 0x80-0xaf, followed by a model load, only
      after a power-on reset of the gauge (the gauge has no non-volatile
      memory).

  maxim,fg-params:
    $ref: /schemas/types.yaml#/definitions/uint16-array
    minItems: 27
    maxItems: 28
    description:
      Register values that go with maxim,fg-model, from the same battery
      model, in this fixed order (register address in parentheses)
        IAvgEmpty (0x36, not written), RelaxCfg (0x2a), LearnCfg (0x28),
        Config (0x1d), Config2 (0xbb), FullSOCThr (0x13), FullCapRep (0x35),
        DesignCap (0x18), dPAcc (0x46), dQAcc (0x45), FullCapNom (0x23),
        VEmpty (0x3a), QRTable00 (0x12), QRTable10 (0x22), QRTable20 (0x32),
        QRTable30 (0x42), RComp0 (0x38), TempCo (0x39), IChgTerm (0x1e),
        TGain (0x2c), TOff (0x2d), Curve (0xb9), MiscCfg (0x2b), AtRate (0x04),
        ConvgCfg (0x49), FilterCfg (0x29), TaskPeriod (0x3c) and, optionally,
        CGain (0x2e, 0x0400 if absent). Capacities are in units of the
        capacity LSB set by TaskPeriod.

dependencies:
  maxim,fg-model: [ 'maxim,fg-params' ]
  maxim,fg-params: [ 'maxim,fg-model' ]

required:
  - compatible
  - reg

unevaluatedProperties: false

examples:
  - |
    i2c {
      #address-cells = <1>;
      #size-cells = <0>;

      battery@36 {
        compatible = "maxim,max17042";
        reg = <0x36>;
        maxim,rsns-microohm = <10000>;
        maxim,over-heat-temp = <600>;
        maxim,over-volt = <4300>;
      };
    };
```

## Documentation/devicetree/bindings/regulator/dlg,slg51002.yaml
```yaml
# SPDX-License-Identifier: GPL-2.0-only OR BSD-2-Clause
%YAML 1.2
---
$id: http://devicetree.org/schemas/regulator/dlg,slg51002.yaml#
$schema: http://devicetree.org/meta-schemas/core.yaml#

title: Dialog Semiconductor SLG51002 camera power management IC

maintainers:
  - Derek Ross <derekross@gmail.com>

description:
  The SLG51002 has eight low dropout regulators (LDO1-LDO5 for analog
  supplies, LDO6-LDO8 for low voltage digital supplies) and four load
  switches. A chip select input wakes it from a low power reset.

properties:
  compatible:
    const: dlg,slg51002

  reg:
    maxItems: 1

  dlg,cs-gpios:
    maxItems: 1
    description:
      Chip select. Driven high to wake the chip, low to put it back into
      its low power reset state.

  vin1-2-supply:
    description: Input supply for LDO1 and LDO2.

  vin3-supply:
    description: Input supply for LDO3.

  vin4-supply:
    description: Input supply for LDO4.

  vin5-supply:
    description: Input supply for LDO5.

  vin6-supply:
    description: Input supply for LDO6.

  vin7-supply:
    description: Input supply for LDO7.

  vin8-supply:
    description: Input supply for LDO8.

  regulators:
    type: object
    additionalProperties: false

    patternProperties:
      "^ldo[1-8]$":
        type: object
        $ref: /schemas/regulator/regulator.yaml#
        unevaluatedProperties: false

        required:
          - regulator-name

      "^sw[1-4]$":
        type: object
        $ref: /schemas/regulator/regulator.yaml#
        unevaluatedProperties: false
        description: Load switch.

        required:
          - regulator-name

required:
  - compatible
  - reg
  - dlg,cs-gpios
  - regulators

additionalProperties: false

examples:
  - |
    #include <dt-bindings/gpio/gpio.h>
    i2c {
        #address-cells = <1>;
        #size-cells = <0>;

        pmic@75 {
            compatible = "dlg,slg51002";
            reg = <0x75>;
            dlg,cs-gpios = <&pmic_gpio 0 GPIO_ACTIVE_HIGH>;
            vin1-2-supply = <&pp3200_bb_cam>;
            vin6-supply = <&pp1300_cam>;

            regulators {
                ldo2 {
                    regulator-name = "uw_avdd";
                    regulator-min-microvolt = <2850000>;
                    regulator-max-microvolt = <2850000>;
                };

                ldo6 {
                    regulator-name = "uw_dvdd";
                    regulator-min-microvolt = <1100000>;
                    regulator-max-microvolt = <1100000>;
                };

                sw4 {
                    regulator-name = "front_sw";
                };
            };
        };
    };
```

## Documentation/devicetree/bindings/regulator/samsung,s2mpg14-regulator.yaml
```yaml
# SPDX-License-Identifier: GPL-2.0-only OR BSD-2-Clause
%YAML 1.2
---
$id: http://devicetree.org/schemas/regulator/samsung,s2mpg14-regulator.yaml#
$schema: http://devicetree.org/meta-schemas/core.yaml#

title: Samsung S2MPG14 Power Management IC regulators

maintainers:
  - W4HO <87742609+W4HO-ham@users.noreply.github.com>

description: |
  LDO4M and LDO25M are programmable voltage outputs of the S2MPG14 PMIC.
  They supply the Pixel 9a touchscreen's analog and digital power rails.

patternProperties:
  "^ldo(4|25)m$":
    type: object
    $ref: regulator.yaml#
    unevaluatedProperties: false
    properties:
      regulator-ramp-delay: false

additionalProperties: false
```

## drivers/gpu/drm/google/Kconfig
```kconfig
# SPDX-License-Identifier: GPL-2.0-only
config DRM_GS_DSIM_CMD
	tristate "Google gs201 DSIM command path for a bootloader display"
	depends on ARCH_EXYNOS || COMPILE_TEST
	depends on OF && DRM
	select DRM_MIPI_DSI
	help
	  Registers a MIPI DSI host on the gs201 (Tensor G2) DSIM so that a
	  panel driver can send DCS commands, for brightness and display
	  on/off, to a panel the bootloader left running. The display
	  pipeline itself stays as the bootloader set it up and is scanned
	  out through simpledrm.

	  This is a bring-up driver until a full DECON/DSIM KMS driver
	  exists. Packets are only sent once the allow_tx module parameter
	  is set.

	  To compile this driver as a module, choose M here: the module
	  will be called gs-dsim-cmd.

config DRM_GS_DECON
	tristate "Google gs201 DECON flip-only KMS driver"
	depends on ARCH_EXYNOS || COMPILE_TEST
	depends on OF && DRM && MMU
	depends on DRM_GS_DSIM_CMD
	select DRM_CLIENT_SELECTION
	select DRM_GEM_DMA_HELPER
	select DRM_KMS_HELPER
	select APERTURE_HELPERS
	help
	  KMS driver for the gs201 (Tensor G2) DECON0 on a display the
	  bootloader left running in DSI command mode. It keeps the
	  bootloader's DECON, DSIM and DSC configuration and only flips
	  DPP0 between scanout buffers, with vblank and page flip events
	  from the DECON frame start interrupt, and switches the panel
	  between 60 and 120 Hz through the DSIM driver. It replaces
	  simpledrm.

	  This is a bring-up driver. For debugging, the stage module
	  parameter limits it to logging the hardware state (0) or to
	  counting frame interrupts (1).

	  To compile this driver as a module, choose M here: the module
	  will be called gs-decon.
```

## drivers/media/platform/samsung/gs201-csis/Kconfig
```kconfig
# SPDX-License-Identifier: GPL-2.0-only

config VIDEO_GS201_CSIS
	tristate "Google gs201 CSIS camera receiver and WDMA"
	depends on V4L_PLATFORM_DRIVERS
	depends on VIDEO_DEV && OF
	depends on ARCH_EXYNOS || COMPILE_TEST
	select MEDIA_CONTROLLER
	select V4L2_FWNODE
	select VIDEO_V4L2_SUBDEV_API
	select VIDEOBUF2_DMA_CONTIG
	select GENERIC_PHY_MIPI_DPHY
	help
	  The MIPI CSI-2 receiver links (CSIS) of the Google gs201 (Tensor G2)
	  camera block and the CSIS WDMA that writes their raw frames to
	  memory, without the rest of the ISP.

	  To compile this driver as a module, choose M here: the module will
	  be called gs201-csis.
```
