## Documentation/devicetree/bindings/clock/google,gs201-clock.yaml
```yaml
# SPDX-License-Identifier: GPL-2.0-only
%YAML 1.2
---
$id: http://devicetree.org/schemas/clock/google,gs201-clock.yaml#
$schema: http://devicetree.org/meta-schemas/core.yaml#

title: Google GS201 SoC clock controller

maintainers:
  - Derek Ross <derekross@gmail.com>

description: |
  The Google GS201 (Tensor G2) clock controller is made of several CMU units,
  each generating clocks for one domain. The CMU units are modelled as
  separate device tree nodes and may depend on each other. The root clock of
  the tree is OSCCLK (24.576 MHz), which must be described as a fixed-rate
  clock in the dts.

  CMU_TOP is the top-level CMU: it prepares the base clocks with PLLs and
  dividers. The other CMUs take their bus and IP clocks from CMU_TOP, except
  CMU_APM, which is in the always-on (ALIVE) domain and runs from its own
  PLL_ALV and OSCCLK. CMU_APM is shared with the APM (ACPM) firmware, so the
  OS only describes the clocks of the peripherals it uses there.

  Each clock is assigned an identifier and client nodes use this identifier
  to name the clock they consume. The identifiers are defined as preprocessor
  macros in 'include/dt-bindings/clock/google,gs201.h'.

properties:
  compatible:
    enum:
      - google,gs201-cmu-top
      - google,gs201-cmu-apm
      - google,gs201-cmu-disp
      - google,gs201-cmu-dpu
      - google,gs201-cmu-hsi0
      - google,gs201-cmu-hsi2
      - google,gs201-cmu-misc
      - google,gs201-cmu-peric0
      - google,gs201-cmu-peric1

  clocks:
    minItems: 1
    maxItems: 5

  clock-names:
    minItems: 1
    maxItems: 5

  "#clock-cells":
    const: 1

  power-domains:
    maxItems: 1

  reg:
    maxItems: 1

  samsung,sysreg:
    $ref: /schemas/types.yaml#/definitions/phandle
    description:
      Phandle to the system registers interface of this CMU's block.

required:
  - compatible
  - "#clock-cells"
  - clocks
  - clock-names
  - reg

allOf:
  - if:
      properties:
        compatible:
          contains:
            enum:
              - google,gs201-cmu-apm
              - google,gs201-cmu-top
    then:
      properties:
        clocks:
          items:
            - description: External reference clock (24.576 MHz)

        clock-names:
          items:
            - const: oscclk

        samsung,sysreg: false

  - if:
      properties:
        compatible:
          contains:
            enum:
              - google,gs201-cmu-disp
              - google,gs201-cmu-dpu
    then:
      properties:
        clocks:
          items:
            - description: External reference clock (24.576 MHz)
            - description: Display (DISP) or DPU bus clock (from CMU_TOP)

        clock-names:
          items:
            - const: oscclk
            - const: bus

  - if:
      properties:
        compatible:
          contains:
            const: google,gs201-cmu-hsi0
    then:
      properties:
        clocks:
          items:
            - description: External reference clock (24.576 MHz)
            - description: HSI0 bus clock (from CMU_TOP)
            - description: DPGTC (from CMU_TOP)
            - description: USB DRD controller clock (from CMU_TOP)
            - description: USB Display Port debug clock (from CMU_TOP)

        clock-names:
          items:
            - const: oscclk
            - const: bus
            - const: dpgtc
            - const: usb31drd
            - const: usbdpdbg

  - if:
      properties:
        compatible:
          contains:
            const: google,gs201-cmu-hsi2
    then:
      properties:
        clocks:
          items:
            - description: External reference clock (24.576 MHz)
            - description: High Speed Interface bus clock (from CMU_TOP)
            - description: High Speed Interface pcie clock (from CMU_TOP)
            - description: High Speed Interface ufs clock (from CMU_TOP)
            - description: High Speed Interface mmc clock (from CMU_TOP)

        clock-names:
          items:
            - const: oscclk
            - const: bus
            - const: pcie
            - const: ufs
            - const: mmc

  - if:
      properties:
        compatible:
          contains:
            const: google,gs201-cmu-misc
    then:
      properties:
        clocks:
          items:
            - description: Misc bus clock (from CMU_TOP)
            - description: Misc sss clock (from CMU_TOP)

        clock-names:
          items:
            - const: bus
            - const: sss

  - if:
      properties:
        compatible:
          contains:
            enum:
              - google,gs201-cmu-peric0
              - google,gs201-cmu-peric1
    then:
      properties:
        clocks:
          items:
            - description: External reference clock (24.576 MHz)
            - description: Connectivity Peripheral 0/1 bus clock (from CMU_TOP)
            - description: Connectivity Peripheral 0/1 IP clock (from CMU_TOP)

        clock-names:
          items:
            - const: oscclk
            - const: bus
            - const: ip

additionalProperties: false

examples:
  - |
    #include <dt-bindings/clock/google,gs201.h>

    cmu_top: clock-controller@1e080000 {
        compatible = "google,gs201-cmu-top";
        reg = <0x1e080000 0x10000>;
        #clock-cells = <1>;
        clocks = <&oscclk>;
        clock-names = "oscclk";
    };

    clock-controller@10010000 {
        compatible = "google,gs201-cmu-misc";
        reg = <0x10010000 0x10000>;
        #clock-cells = <1>;
        clocks = <&cmu_top CLK_DOUT_CMU_MISC_NOC>,
                 <&cmu_top CLK_DOUT_CMU_MISC_SSS>;
        clock-names = "bus", "sss";
    };

...
```

## Documentation/devicetree/bindings/clock/google,zumapro-clock.yaml
```yaml
# SPDX-License-Identifier: (GPL-2.0-only OR BSD-2-Clause)
%YAML 1.2
---
$id: http://devicetree.org/schemas/clock/google,zumapro-clock.yaml#
$schema: http://devicetree.org/meta-schemas/core.yaml#

title: Google Tensor G4 clock controllers

maintainers:
  - W4HO <87742609+W4HO-ham@users.noreply.github.com>

description: |
  CMU_TOP supplies the NoC and UFS clock paths to CMU_HSI2 and the supply-GPIO
  path in CMU_PERIC0. CMU_TOP also provides the HSI0 parent rate paths.
  CMU_MISC supplies the firmware-owned watchdog bus clock paths.
  CMU_HSI0 supplies the USB, eUSB2 PHY and touchscreen USI2 clocks; its
  ALT and TCXO inputs are board-level fixed clocks.
  CMU_G3D supplies the GPU's core, coregroup and stacks clocks from its two
  PLLs and CMU_TOP's G3D NoC, global and switch clocks.
  CMU_HSI1 supplies the HSI1 GPIO bank's clock; its ALT input is a
  board-level fixed clock.
  CMU_APM supplies the always-on GPIO banks, the APM mailbox and its
  internal memory from the always-on ALV PLL and the oscillator.
  CMU_PERIC1 supplies the PERIC1 GPIO bank and USI9 (the I2C bus of the
  NFC controller and the haptics driver) from CMU_TOP's PERIC1 NoC and IP
  clocks.
  The external oscillator supplies the PLL reference and oscillator mux
  paths.
  Clock identifiers are defined in dt-bindings/clock/google,zumapro.h.

properties:
  compatible:
    enum:
      - google,zumapro-cmu-top
      - google,zumapro-cmu-apm
      - google,zumapro-cmu-g3d
      - google,zumapro-cmu-hsi0
      - google,zumapro-cmu-hsi1
      - google,zumapro-cmu-hsi2
      - google,zumapro-cmu-peric0
      - google,zumapro-cmu-peric1
      - google,zumapro-cmu-misc

  reg:
    maxItems: 1

  "#clock-cells":
    const: 1

  clocks:
    minItems: 1
    maxItems: 5

  clock-names:
    minItems: 1
    maxItems: 5

  power-domains:
    maxItems: 1

required:
  - compatible
  - reg
  - "#clock-cells"
  - clocks
  - clock-names

allOf:
  - if:
      properties:
        compatible:
          enum:
            - google,zumapro-cmu-top
            - google,zumapro-cmu-apm
    then:
      properties:
        clocks:
          items:
            - description: External oscillator reference clock
        clock-names:
          items:
            - const: oscclk
  - if:
      properties:
        compatible:
          const: google,zumapro-cmu-hsi0
    then:
      properties:
        clocks:
          items:
            - description: External oscillator reference clock
            - description: HSI0 NoC clock from CMU_TOP
            - description: HSI0 peripheral clock from CMU_TOP
            - description: HSI0 ALT input clock
            - description: HSI0 TCXO input clock
        clock-names:
          items:
            - const: oscclk
            - const: bus
            - const: peri
            - const: alt
            - const: tcxo
  - if:
      properties:
        compatible:
          const: google,zumapro-cmu-hsi1
    then:
      properties:
        clocks:
          items:
            - description: External oscillator reference clock
            - description: HSI1 NoC clock from CMU_TOP
            - description: HSI1 ALT input clock
        clock-names:
          items:
            - const: oscclk
            - const: bus
            - const: alt
  - if:
      properties:
        compatible:
          not:
            enum:
              - google,zumapro-cmu-hsi0
              - google,zumapro-cmu-hsi1
    then:
      properties:
        power-domains: false
  - if:
      properties:
        compatible:
          const: google,zumapro-cmu-g3d
    then:
      properties:
        clocks:
          items:
            - description: External oscillator reference clock
            - description: G3D NoC clock from CMU_TOP
            - description: G3D global clock from CMU_TOP
            - description: G3D switch clock from CMU_TOP
        clock-names:
          items:
            - const: oscclk
            - const: bus
            - const: glb
            - const: switch
  - if:
      properties:
        compatible:
          const: google,zumapro-cmu-hsi2
    then:
      properties:
        clocks:
          items:
            - description: HSI2 oscillator clock
            - description: HSI2 NoC clock from CMU_TOP
            - description: HSI2 UFS clock from CMU_TOP
            - description: HSI2 PCIe clock from CMU_TOP
        clock-names:
          items:
            - const: oscclk
            - const: bus
            - const: ufs
            - const: pcie
  - if:
      properties:
        compatible:
          const: google,zumapro-cmu-peric1
    then:
      properties:
        clocks:
          items:
            - description: External oscillator reference clock
            - description: PERIC1 NoC clock from CMU_TOP
            - description: PERIC1 USI input clock from CMU_TOP
        clock-names:
          items:
            - const: oscclk
            - const: bus
            - const: ip
  - if:
      properties:
        compatible:
          enum:
            - google,zumapro-cmu-peric0
            - google,zumapro-cmu-misc
    then:
      properties:
        clocks:
          items:
            - description: Domain oscillator reference clock
            - description: Domain NoC clock from CMU_TOP
        clock-names:
          items:
            - const: oscclk
            - const: bus

additionalProperties: false

examples:
  - |
    #include <dt-bindings/clock/google,zumapro.h>

    cmu_top: clock-controller@26040000 {
        compatible = "google,zumapro-cmu-top";
        reg = <0x26040000 0x8000>;
        #clock-cells = <1>;
        clocks = <&oscclk>;
        clock-names = "oscclk";
    };

    clock-controller@11000000 {
        compatible = "google,zumapro-cmu-hsi0";
        reg = <0x11000000 0x8000>;
        #clock-cells = <1>;
        clocks = <&oscclk>, <&cmu_top CLK_DOUT_HSI0_NOC>,
                 <&cmu_top CLK_DOUT_HSI0_PERI>, <&hsi0_alt>, <&hsi0_tcxo>;
        clock-names = "oscclk", "bus", "peri", "alt", "tcxo";
    };

    clock-controller@13000000 {
        compatible = "google,zumapro-cmu-hsi2";
        reg = <0x13000000 0x8000>;
        #clock-cells = <1>;
        clocks = <&oscclk>, <&cmu_top CLK_DOUT_HSI2_NOC>,
                 <&cmu_top CLK_DOUT_HSI2_UFS>,
                 <&cmu_top CLK_DOUT_HSI2_PCIE>;
        clock-names = "oscclk", "bus", "ufs", "pcie";
    };

    clock-controller@10010000 {
        compatible = "google,zumapro-cmu-misc";
        reg = <0x10010000 0x8000>;
        #clock-cells = <1>;
        clocks = <&oscclk>, <&cmu_top CLK_DOUT_MISC_NOC>;
        clock-names = "oscclk", "bus";
    };

    clock-controller@10800000 {
        compatible = "google,zumapro-cmu-peric0";
        reg = <0x10800000 0x8000>;
        #clock-cells = <1>;
        clocks = <&oscclk>, <&cmu_top CLK_DOUT_PERIC0_NOC>;
        clock-names = "oscclk", "bus";
    };

    clock-controller@12000000 {
        compatible = "google,zumapro-cmu-hsi1";
        reg = <0x12000000 0x8000>;
        #clock-cells = <1>;
        clocks = <&oscclk>, <&cmu_top CLK_DOUT_HSI1_NOC>, <&hsi1_alt>;
        clock-names = "oscclk", "bus", "alt";
    };

    clock-controller@10c00000 {
        compatible = "google,zumapro-cmu-peric1";
        reg = <0x10c00000 0x8000>;
        #clock-cells = <1>;
        clocks = <&oscclk>, <&cmu_top CLK_DOUT_PERIC1_NOC>,
                 <&cmu_top CLK_DOUT_PERIC1_IP>;
        clock-names = "oscclk", "bus", "ip";
    };

    clock-controller@15400000 {
        compatible = "google,zumapro-cmu-apm";
        reg = <0x15400000 0x8000>;
        #clock-cells = <1>;
        clocks = <&oscclk>;
        clock-names = "oscclk";
    };

    clock-controller@1ee00000 {
        compatible = "google,zumapro-cmu-g3d";
        reg = <0x1ee00000 0x8000>;
        #clock-cells = <1>;
        clocks = <&oscclk>, <&cmu_top CLK_DOUT_G3D_NOCD>,
                 <&cmu_top CLK_DOUT_G3D_GLB>, <&cmu_top CLK_DOUT_G3D_SWITCH>;
        clock-names = "oscclk", "bus", "glb", "switch";
    };
...
```

## Documentation/devicetree/bindings/display/panel/google,tg4c.yaml
```yaml
# SPDX-License-Identifier: GPL-2.0-only OR BSD-2-Clause
%YAML 1.2
---
$id: http://devicetree.org/schemas/display/panel/google,tg4c.yaml#
$schema: http://devicetree.org/meta-schemas/core.yaml#

title: Google TG4C AMOLED DSI panel

description:
  The TG4C is the 1080x2424 command-mode AMOLED panel of the Google Pixel
  9a. It takes DSC 1.2 compressed pixel data (two 540x24 slices at 8 bits
  per pixel) over four MIPI DSI lanes, reports its refresh timing on a
  tearing effect (TE) line and runs at 60 or 120 Hz.

maintainers:
  - W4HO <87742609+W4HO-ham@users.noreply.github.com>

allOf:
  - $ref: panel-common.yaml#

properties:
  compatible:
    const: google,tg4c

  reg:
    maxItems: 1

  reset-gpios: true

  vddi-supply:
    description: I/O supply

  vddd-supply:
    description: Digital core supply

  vci-supply:
    description: Analog supply

required:
  - compatible
  - reg

unevaluatedProperties: false

examples:
  - |
    #include <dt-bindings/gpio/gpio.h>

    dsi {
        #address-cells = <1>;
        #size-cells = <0>;

        panel@0 {
            compatible = "google,tg4c";
            reg = <0>;
            reset-gpios = <&gpp0 0 GPIO_ACTIVE_LOW>;
            vci-supply = <&vci>;
            vddi-supply = <&vddi>;
            vddd-supply = <&vddd>;
        };
    };

...
```
